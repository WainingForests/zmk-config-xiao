## config/boards/shields/6x5_manuform/Kconfig.defconfig
```kconfig
if SHIELD_6x5_MANUFORM_LEFT

config ZMK_KEYBOARD_NAME
    default "6x5 Manuform"

config ZMK_SPLIT_ROLE_CENTRAL
    default y
    
config_ZMK_RGB_UNDERGLOW=y
# Use the STRIP config specific to the LEDs you're using
CONFIG_WS2812_STRIP=y

endif

if SHIELD_6x5_MANUFORM

config ZMK_SPLIT
    default y
    
CONFIG_ZMK_RGB_UNDERGLOW=y
# Use the STRIP config specific to the LEDs you're using
CONFIG_WS2812_STRIP=y

endif
```

## config/boards/shields/6x5_manuform/Kconfig.shield
```kconfig
config SHIELD_6x5_MANUFORM
    bool

config SHIELD_6x5_MANUFORM_LEFT
    def_bool $(shields_list_contains,6x5_manuform_left)
    select SHIELD_6x5_MANUFORM

config SHIELD_6x5_MANUFORM_RIGHT
    def_bool $(shields_list_contains,6x5_manuform_right)
    select SHIELD_6x5_MANUFORM
```

## config/boards/shields/6x5_manuform/boards/seeeduino_xiao_ble.conf
```kconfig
CONFIG_SPI=y
# Set NFC Pins on Xaio as GPIO - Do this only once then comment out
# CONFIG_NFCT_PINS_AS_GPIOS=y
```

## config/west.yml
```yaml
manifest:
  remotes:
    - name: zmkfirmware
      url-base: https://github.com/zmkfirmware
    - name: ftc
      url-base: https://github.com/ftc
  projects:
    - name: zmk
      remote: zmkfirmware
      revision: main
      import: app/west.yml
  self:
    path: config
```
